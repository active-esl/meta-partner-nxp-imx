// SPDX-License-Identifier: (GPL-2.0+ OR MIT)
/*
 * Copyright 2025 Dynamic Devices Ltd
 * Minimal board DTS for lmp-device-tree / mfgtool FIT.
 * The complete hardware description is supplied by linux-lmp-fslc-imx.
 */

/dts-v1/;

#include "imx95.dtsi"

/ {
	model = "NXP i.MX95 15X15 FRDM board";
	compatible = "fsl,imx95-15x15-frdm", "fsl,imx95";

	chosen {
		stdout-path = &lpuart1;
	};

	bootloader {
		compatible = "lmp,bootloader";
	};
};
